## Kconfig
```kconfig
config SNAPSHOT_ON_DISK
	bool "Snapshots on-disk format changes"
	help
	  Snapshots uses a few reserved fields and flags in the Ext2 super block,
	  and inode structs.
	  Snapshots require the compatible feature 'exclude_bitmap', meaning that
	  the exclude bitmap was allocated.
	  snapshots require the read-only compatible features 'has_snapshot',
	  meaning that the file system may contain snapshots.

config SNAPSHOT_BIG_JOURNAL
	bool "Create a big journal for COW operations"
	help
	  COW transactions reserve up to 24 times more credits than traditional
	  transactions for the same operation.  On mke2fs and tune2fs, if the
	  '-J big' option is used to create a journal, increase the default
	  journal size by a factor of 24.

config SNAPSHOT_EXCLUDE_INODE
	bool "Create/check the special exclude inode"
	help
	  The exclude inode owns all the exclude bitmap blocks.
	  It is pre-allocated by 'mke2fs/tune2fs -O exclude_inode'.
	  It is extended by resize2fs when block groups are added.
	  Fsck checks that all exclude inode blocks are allocated.

config SNAPSHOT_CTL
	bool "Snapshot control with chsnap/lssnap"
	help
	  Set/clear snapshots parent directory with chattr +/-x.
	  Take/delete snapshot with chsnap +/-S.
	  Enable/disable snapshot with chsnap +/-n.
	  View snapshot status with lssnap.

config SNAPSHOT_HAS_SNAPSHOT
	bool "Avoid offline modifications to a file system with snapshots"
	help
	  Snapshots require the read-only compatible feature 'has_snapshot',
	  so the file system will be mounted by old kernels in read-only mode
	  to protect the snapshots.
	  Fsck displays a warning about possible corruption of the snapshots
	  in interactive mode and avoids freeing blocks in preen mode.

config SNAPSHOT_CLEANUP
	bool "Cleanup snapshot list when removing has_snapshot feature"
	help
	  Discard all snapshots by 'tune2fs -O ^has_snapshot'.
	  Snapshot inodes are chained on a list starting at the super block.
	  Delete all snapshot inodes on the list and reset exclude bitmap.

config SNAPSHOT_EXCLUDE_BITMAP
	bool "Create/check the exclude bitmap"
	help
	  Excluding snapshot blocks from COW is done by setting their bit in
	  the exclude bitmap. There is one exclude bitmap block per block group.
	  Mke2fs allocates the exclude bitmap and it cannot be removed.
	  Fsck checks that all (and only) snapshot file blocks are excluded.

config SNAPSHOT_CHECK_LIST
	bool "Check snapshot list on fsck"
	help
	  Check that all inodes on snapshot list are valid snapshots and
	  prompt to terminate list when bad inode is found.

config SNAPSHOT_FIX_SNAPSHOT
	bool "Delete all snapshots on fsck -x"
	help
	  On fsck -x or if the 'fix_snapshot' flag is set, prompt to delete
	  all snapshot inodes and reset exclude bitmap.

config SNAPSHOT_HUGE_SNAPSHOT
	bool "Map maximum filesystem size with a single snapshot file"
	help
	  To map 2^32 logical blocks, 4 triple indirect blocks are used instead
	  of just one.  The extra 3 triple indirect blocks are stored in-place
	  of direct blocks, which are not in use by snapshot files.
	  Snapshots cannot be enabled on filesytem with block size < 4K.

config SNAPSHOT_MESSAGE_BUFFER
	bool "Dump message buffer on fsck"
	help
	  Error messages are recorded in a message buffer after the
	  journal super block.  On journal recovery, the journal message buffer
	  is copied to the file system message buffer.  On fsck, if the message
	  buffer is not empty, the recorded messages are printed to stdout and
	  the buffer is cleared.
	  With a default block size of 4K, there is always 2K of free
	  space for the message buffer after the 1K super block.

config SNAPSHOT_CTL_OLD
	bool "Old next3 snapshot control with chattr/lsattr -X"
	help
	  Take/delete snapshot with chattr -X +/-S.
	  Enable/disable snapshot with chattr -X +/-n.
	  View snapshot status with lsattr -X.
```
